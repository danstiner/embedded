/* Ensure MCUboot uses boot_partition */
/ {
	chosen {
		zephyr,code-partition = &boot_partition;
	};
};

/* MCUboot doesn't need the PMIC - remove entire node tree */
&i2c20 {
	status = "disabled";
	/delete-node/ pmic@6b;
};
