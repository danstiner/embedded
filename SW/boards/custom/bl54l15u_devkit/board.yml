## SW/boards/custom/bl54l15u_devkit/board.yml
```yaml
board:
  name: bl54l15u_devkit
  full_name: BL54L15u DevKit
  vendor: custom
  socs:
    - name: nrf54l15
  revision:
    format: custom
    default: 2026v2
    revisions:
    - name: 2026v1
    - name: 2026v2
runners:
  run_once:
    '--recover':
      - runners:
          - nrfjprog
          - nrfutil
        run: first
        groups:
          - boards:
              - bl54l15u_devkit
```

## SW/boards/custom/bl54l15u_hygrometer/board.yml
```yaml
board:
  name: bl54l15u_hygrometer
  full_name: BL54L15u Hygrometer
  vendor: custom
  socs:
    - name: nrf54l15
  revision:
    format: custom
    # 2026v4 is the current production hardware and the default. Build older
    # boards explicitly with `@2026v3`.
    default: 2026v4
    revisions:
    - name: 2026v3
    - name: 2026v4
runners:
  run_once:
    '--recover':
      - runners:
          - nrfjprog
          - nrfutil
        run: first
        groups:
          - boards:
              - bl54l15u_hygrometer
```

## SW/boards/local/bl54l15u_devkit/Kconfig.bl54l15u_devkit
```kconfig
config BOARD_BL54L15U_DEVKIT
	select SOC_NRF54L15_CPUAPP if BOARD_BL54L15U_DEVKIT_NRF54L15_CPUAPP
```

## SW/boards/local/bl54l15u_hygrometer/Kconfig.bl54l15u_hygrometer
```kconfig
config BOARD_BL54L15U_HYGROMETER
	select SOC_NRF54L15_CPUAPP if BOARD_BL54L15U_HYGROMETER_NRF54L15_CPUAPP
```

## SW/boards/local/bl54l15u_hygrometer/board.yml
```yaml
board:
  name: bl54l15u_hygrometer
  full_name: BL54L15u Hygrometer
  vendor: local
  socs:
    - name: nrf54l15
  revision:
    format: custom
    default: 2026v4
    revisions:
    - name: 2026v3
    - name: 2026v4
runners:
  run_once:
    '--recover':
      - runners:
          - nrfjprog
          - nrfutil
        run: first
        groups:
          - boards:
              - bl54l15u_hygrometer
```

## SW/boards/nordic/bl54l15u_devkit/Kconfig.defconfig
```kconfig
# Copyright (c) 2024 Dan Stiner
# SPDX-License-Identifier: Apache-2.0

config HW_STACK_PROTECTION
	default ARCH_HAS_STACK_PROTECTION
```

## SW/boards/nordic/bl54l15u_hygrometer/board.yml
```yaml
board:
  name: bl54l15u_hygrometer
  full_name: BL54L15u Hygrometer
  vendor: nordic
  socs:
    - name: nrf54l15
runners:
  run_once:
    '--recover':
      - runners:
          - nrfjprog
          - nrfutil
        run: first
        groups:
          - boards:
              - bl54l15u_hygrometer
```

## SW/hygrometer/tests/leak/testcase.yaml
```yaml
tests:
  hygrometer.sensor.leak:
    platform_allow:
      - native_sim
      - qemu_cortex_m3
    tags:
      - leak
      - sensor
      - unit
```

## SW/soil_sensor/drivers/sensor/fdc1004/Kconfig
```kconfig
config FDC1004
	bool "TI FDC1004 Capacitance-to-Digital Converter"
	default y
	depends on DT_HAS_TI_FDC1004_ENABLED
	select I2C
	help
	  Enable driver for TI FDC1004 4-Channel Capacitance-to-Digital Converter.
```

## SW/west/west.yml
```yaml
manifest:
  self:
    path: west
  remotes:
    - name: ncs
      url-base: https://github.com/nrfconnect
  projects:
    - name: nrf
      remote: ncs
      repo-path: sdk-nrf
      revision: v3.3.0
      import:
        path-prefix: west/ncs
    # Zigbee R23 add-on (precompiled ZBOSS)
    - name: ncs-zigbee
      remote: ncs
      repo-path: ncs-zigbee
      # Pinned SHA tracking our NCS revision
      revision: 8a6c6ca5b26c8768dc3b52eb7714eb6b7fe61915
      path: west/ncs/ncs-zigbee
```
