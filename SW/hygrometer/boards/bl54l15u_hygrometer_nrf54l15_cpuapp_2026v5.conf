## SW/hygrometer/tests/leak_bidir/testcase.yaml
```yaml
tests:
  hygrometer.sensor.leak_bidir:
    platform_allow:
      - native_sim
      - qemu_cortex_m3
    tags:
      - leak
      - sensor
      - unit
```

## SW/hygrometer/tests/stcc4/testcase.yaml
```yaml
tests:
  hygrometer.sensor.stcc4:
    platform_allow:
      - native_sim
      - qemu_cortex_m3
    tags:
      - stcc4
      - sensor
      - unit
```
