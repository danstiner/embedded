## SW/hygrometer/boards/nrf54l15dk_nrf54l15_cpuapp_internal.conf
```kconfig
# Disable SPI and external flash - using internal RRAM
CONFIG_CHIP_SPI_NOR=n
CONFIG_SPI=n
CONFIG_SPI_NOR=n

# Enable LTO to decrease the flash usage.
CONFIG_LTO=y
CONFIG_ISR_TABLES_LOCAL_DECLARATION=y

# Disable NFC (Matter and nRF levels)
CONFIG_CHIP_NFC_ONBOARDING_PAYLOAD=n
CONFIG_NFC_T2T_NRFXLIB=n
CONFIG_NFC_T4T_NRFXLIB=n
```

## SW/hygrometer/sysbuild/mcuboot/boards/nrf54l15dk_nrf54l15_cpuapp_internal.conf
```kconfig
# MCUboot config for internal flash builds
# Disable logging and serial to save space and power

CONFIG_LOG=n
CONFIG_CONSOLE=n
CONFIG_SERIAL=n
CONFIG_UART_CONSOLE=n
CONFIG_PRINTK=n

# Disable SPI for external flash
CONFIG_SPI=n
CONFIG_SPI_NOR=n
```
