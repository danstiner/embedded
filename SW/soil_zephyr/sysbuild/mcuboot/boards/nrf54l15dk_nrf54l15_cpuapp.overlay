/* MCUboot overlay for nRF54L15 DK - internal RRAM only */

/* Restore full RRAM and SRAM space - by default some parts are dedicated to FLPR */
&cpuapp_rram {
	reg = <0x0 DT_SIZE_K(1524)>;
};

&cpuapp_sram {
	reg = <0x20000000 DT_SIZE_K(256)>;
	ranges = <0x0 0x20000000  0x40000>;
};

/* Disable external flash */
&mx25r64 {
	status = "disabled";
};
